/*
 * Novatek Ltd. BSP part of dts
 */

/ {
		audio_i2s_part {
		  /*<i2s_num>, <enable>, <channel >, <data_stereo>, <sample_size>, <sample_rate>, <bit_clk >, <i2s_master>*/
		  i2s = 
				<0      >, <1     >, <16      >, <0          >, <16         >, <8000       >, <2048000 >, <1         >,
				<1      >, <0     >, <16      >, <0          >, <16         >, <8000       >, <2048000 >, <0         >,
				<2      >, <1     >, <2       >, <1          >, <16         >, <48000      >, <1536000 >, <1         >,
				/*<3      >, <1     >, <1       >, <1          >, <16         >, <48000      >, <3072000 >, <1         >,*/
				<6      >, <1     >, <1       >, <1          >, <16         >, <48000      >, <3072000 >, <1         >;	  // I2S6 dedicate for HDMI tx only
    };
    	audio_mclk_part {
    		/*<i2s_num>, <mclk>*/
          mclk =
                <0      >, <12288000     >,
                <1      >, <12288000     >,
                <2      >, <12288000     >;
                /*<3      >, <12288000     >;*/
    };

};

