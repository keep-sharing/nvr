## src/boards/hi3536a/hiboot/u-boot-2020.01/arch/arm/mach-vendor/Kconfig
```kconfig
if ARCH_VENDOR

config VENDOR_COMMON
    bool "VENDOR common options"
    select DM

config SYS_VENDOR
    default "vendor"

endif

config DISABLE_INTERRUPTS
    bool "disable interrupts"
    default n

config LOW_DELAY_INITIALIZATION
    bool "low delay initialization"
    default n

config INIT_TIMER_EARLY
    bool "init timer early"
    default n
```

## src/boards/hi3536a/hiboot/u-boot-2020.01/board/vendor/ss626v100/Kconfig
```kconfig
if TARGET_SS626V100

config SYS_BOARD
	default "ss626v100"

config SYS_VENDOR
	default "vendor"

config SYS_SOC
	default "ss626v100"

config SYS_CONFIG_NAME
	default "ss626v100"

endif
```

## src/boards/hi3536a/hiboot/u-boot-2020.01/product/Kconfig
```kconfig
menu "Product"

source "product/ot_osd/Kconfig"
source "product/update/Kconfig"
source "product/security_subsys/Kconfig"

endmenu
```

## src/boards/hi3536a/hiboot/u-boot-2020.01/product/security_subsys/Kconfig
```kconfig
config CIPHER_ENABLE
	bool "cipher enable"

config KLAD_ENABLE
	bool "klad enable"
config OTP_ENABLE
	bool "otp enable"
	depends on TARGET_SS928V100 || TARGET_SS626V100
```

## src/boards/hi3536a/hiboot/u-boot-2020.01/product/update/Kconfig
```kconfig
config AUTO_UPDATE
	bool "auto update"
	select FS_FAT

config AUTO_SD_UPDATE
	bool "auto sd update"
	depends on AUTO_UPDATE
	depends on !TARGET_SS626V100

config AUTO_USB_UPDATE
	bool "auto usb update"
	select USB
	select USB_GADGET
	depends on AUTO_UPDATE

config AUTO_UPDATE_ADAPTATION
	bool "auto update adaptation"
	depends on AUTO_UPDATE
```

## src/boards/nt98323/hiboot/uboot/drivers/ddr/novatek/Kconfig
```kconfig
menu "Novatek DDR Scan Support"

config NVT_DDR_SCAN
	bool "To support DDR range scan utils"
	default n
	help
	  This option is used to lunch range scan.

choice
	prompt "DDR scan UARTx selection"
	default NVT_DDR_SCAN_OUTPUT_MESSAGE_TO_UART0
	help
	  select UART set for range scan
config NVT_DDR_SCAN_OUTPUT_MESSAGE_TO_UART0
	bool "To support DDR range scan utils output message to UART0"
	depends on NVT_DDR_SCAN
	help
	  This option is used to lunch range scan.

config NVT_DDR_SCAN_OUTPUT_MESSAGE_TO_UART1
	bool "To support DDR range scan utils output message to UART1"
	depends on NVT_DDR_SCAN
	help
	  This option is used to lunch range scan.

config NVT_DDR_SCAN_OUTPUT_MESSAGE_TO_UART2
	bool "To support DDR range scan utils output message to UART2"
	depends on NVT_DDR_SCAN
	help
	  This option is used to lunch range scan.

endchoice

endmenu
```

## src/boards/nt98323/hiboot/uboot/drivers/mmc/Kconfig
```kconfig
menu "MMC Host controller Support"

config MMC
	bool "Enable MMC support"
	depends on (ARCH_NA51068_A32 || ARCH_SUNXI || SANDBOX || ARCH_NT72172_A32 || ARCH_NT72172_A64 || ARCH_NT72673_A32 || ARCH_NT72673_A64 || ARCH_NT72671_A32 || ARCH_NT72671_A64)
	help
	  TODO: Move all architectures to use this option

config DM_MMC
	bool "Enable MMC controllers using Driver Model"
	depends on DM
	help
	  This enables the MultiMediaCard (MMC) uclass which suports MMC and
	  Secure Digital I/O (SDIO) cards. Both removable (SD, micro-SD, etc.)
	  and non-removable (e.g. eMMC chip) devices are supported. These
	  appear as block devices in U-Boot and can support filesystems such
	  as EXT4 and FAT.

config MSM_SDHCI
	bool "Qualcomm SDHCI controller"
	depends on DM_MMC
	help
	  Enables support for SDHCI 2.0 controller present on some Qualcomm
          Snapdragon devices. This device is compatible with eMMC v4.5 and
          SD 3.0 specifications. Both SD and eMMC devices are supported.
	  Card-detect gpios are not supported.

config ROCKCHIP_DWMMC
	bool "Rockchip SD/MMC controller support"
	depends on DM_MMC && OF_CONTROL
	help
	  This enables support for the Rockchip SD/MMM controller, which is
	  based on Designware IP. The device is compatible with at least
	  SD 3.0, SDIO 3.0 and MMC 4.5 and supports common eMMC chips as well
	  as removeable SD and micro-SD cards.

config SH_SDHI
	bool "SuperH/Renesas ARM SoCs on-chip SDHI host controller support"
	depends on RMOBILE
	help
	  Support for the on-chip SDHI host controller on SuperH/Renesas ARM SoCs platform

config PIC32_SDHCI
	bool "Microchip PIC32 on-chip SDHCI support"
	depends on DM_MMC && MACH_PIC32
	help
	  Support for Microchip PIC32 SDHCI controller.

config ZYNQ_SDHCI
	bool "Arasan SDHCI controller support"
	depends on DM_MMC && OF_CONTROL
	help
	  Support for Arasan SDHCI host controller on Zynq/ZynqMP ARM SoCs platform

config MMC_UNIPHIER
	bool "UniPhier SD/MMC Host Controller support"
	depends on ARCH_UNIPHIER
	help
	  This selects support for the SD/MMC Host Controller on UniPhier SoCs.

config SANDBOX_MMC
	bool "Sandbox MMC support"
	depends on MMC && SANDBOX
	help
	  This select a dummy sandbox MMC driver. At present this does nothing
	  other than allow sandbox to be build with MMC support. This
	  improves build coverage for sandbox and makes it easier to detect
	  MMC build errors with sandbox.

config NVT_COMMON_EMMC
	bool "Novatek EMMC support"
	depends on MMC && (ARCH_NT72172_A32 || ARCH_NT72172_A64 || ARCH_NT72673_A32 || ARCH_NT72673_A64 || ARCH_NT72671_A32 || ARCH_NT72671_A64)
	help
	  This select a Novatek EMMC host controller driver.

config NVT_COMMON_EMMC_LEGACY
	bool "Novatek legacy EMMC support"
	depends on MMC && (ARCH_NT72172_A32 || ARCH_NT72172_A64 || ARCH_NT72673_A32 || ARCH_NT72673_A64 || ARCH_NT72671_A32 || ARCH_NT72671_A64)
	help
	  This select a Novatek legacy EMMC host controller driver.
	  
config NVT_IVOT_MMC
	bool "Novatek IVOT MMC support"
	depends on MMC && ARCH_NA51068_A32
	help
	  This select a Novatek IVOT MMC host controller driver.
	  
config NVT_MMC
	bool "Novatek MMC support"
	depends on (ARCH_NA51000_A32 || ARCH_NA51055_A32 || ARCH_NA51068_A32)
	help
	  This select a Novatek MMC host controller driver.

config NVT_MMC_MAX_NUM
	int "Maximum MMC channel number"
	depends on NVT_MMC
	default 1
	help
	  This select the maximum number of Novatek MMC host controller driver.

config NVT_MMC_CHANNEL_SDIO1
	bool "Novatek MMC support channel SDIO1"
	depends on NVT_MMC
	help
	  This select channel of Novatek MMC host controller driver.

config SD_CARD1_POWER_CONTROL
	bool "SD CARD1 Power control"
	depends on NVT_MMC_CHANNEL_SDIO1
	help
	  This select power control of sd card1.

config SD_CARD1_POWER_PIN
	int "SD CARD1 Power pin number"
	depends on SD_CARD1_POWER_CONTROL
	help
	  This select power pin of sd card1.

config SD_CARD1_ON_STATE
	int "SD CARD1 Power on state"
	depends on SD_CARD1_POWER_CONTROL
	help
	  This select power on state of sd card1.

config NVT_MMC_CHANNEL_SDIO2
	bool "Novatek MMC support channel SDIO2"
	depends on NVT_MMC
	help
	  This select channel of Novatek MMC host controller driver.

config SD_CARD2_POWER_CONTROL
	bool "SD CARD2 Power control"
	depends on NVT_MMC_CHANNEL_SDIO2
	help
	  This select power control of sd card2.

config SD_CARD2_POWER_PIN
	int "SD CARD2 Power pin number"
	depends on SD_CARD2_POWER_CONTROL
	help
	  This select power pin of sd card2.

config SD_CARD2_ON_STATE
	int "SD CARD2 Power on state"
	depends on SD_CARD2_POWER_CONTROL
	help
	  This select power on state of sd card2.

config NVT_MMC_CHANNEL_SDIO3
	bool "Novatek MMC support channel SDIO3"
	depends on NVT_MMC
	help
	  This select channel of Novatek MMC host controller driver.

endmenu
```

## src/boards/nt98633/hiboot/uboot/board/novatek/common/Kconfig
```kconfig
menu "Novatek IVOT features"
config NVT_IVOT_SOC
	bool "Novatek IVOT series soc"
	help
	  This option can be used to enable ivot features.

config NVT_FPGA_EMULATION
	bool "Novatek IVOT FPGA emulation"
	default n
	help
	  This option can be used to enable FPGA emulation.

config NVT_IVOT_SOC_FW_UPDATE_SUPPORT
	bool "Novatek IVOT FW update utils"
	default n
	help
	  This option can be used to support fdt parsing and update api.

config NVT_IVOT_SOC_UTILS
	bool "Novatek IVOT utils"
	default n
	help
	  To support IVOT proprietary utilities.

config NVT_IVOT_SOC_BOOT_FROM_RAM
	bool "Novatek IVOT FW boot from ram"
	default n
	help
	  To support IVOT FW only boot from ram.

config NVT_IVOT_NVT_DBG
	bool "Novatek IVOT debug setting"
	default n
	help
	  To support IVOT message debug function.

config NVT_IVOT_DEBUG_LEVEL
	int "Debug msg print level (0-8)"
        default 4
        depends on NVT_IVOT_NVT_DBG
        help
          0 ~ 8: 8 is to turn on all print message

config NVT_IVOT_BOOT_FAST
	bool "Let your uboot booting time faster"
	default n
	help
	  This option can be used to accelerate boot time.

config NVT_IVOT_OPTEE_SUPPORT
	bool "To support the optee utils"
	default n
	help
	  This option is used to communicate with optee secure os.

config NVT_IVOT_OPTEE_SECBOOT_SUPPORT
	bool "To support secure boot flow with optee"
	depends on NVT_IVOT_OPTEE_SUPPORT
	default n
	help
	  To support secure boot flow with optee

config NVT_IVOT_TZPC_SUPPORT
	bool "To support TZPC related utils"
	default n
	help
	  This option is used to simple verify TZPC.

config NVT_IVOT_DDR_RANGE_SCAN_SUPPORT
	bool "To support DDR range scan utils"
	default n
	help
	  This option is used to lunch range scan.

	if NVT_IVOT_DDR_RANGE_SCAN_SUPPORT
    	menu "Novatek DDR scan uart selection"
			
			config NVT_DDR_SCAN_OUTPUT_MESSAGE_TO_UART0
				bool "DDR range scan utils output message to UART0"

			config NVT_DDR_SCAN_OUTPUT_MESSAGE_TO_UART1
				bool "DDR range scan utils output message to UART1"

			config NVT_DDR_SCAN_OUTPUT_MESSAGE_TO_UART2
				bool "DDR range scan utils output message to UART2"

        endmenu
	endif

config NVT_IVOT_STBC_PMC_SUPPORT
	bool "To support STBC power down utils"
	depends on TARGET_NA51102_A64
	default n
	help
	  This option is used to lunch range scan.

config VIDEO_LOGO
	bool "To support display LOGO"
	default n
	help
	  This option is used to lunch display LOGO.

config NVT_IVOT_CRYPTO_CMD
	bool "To support crypto engine command"
	depends on NVT_IVOT_SOC && NVT_IVOT_OPTEE_SUPPORT=n
	help
	  Novatek iVot Crypto Engine Command support.

config NVT_IVOT_HASH_CMD
	bool "To support hash engine command"
	depends on NVT_IVOT_SOC && NVT_IVOT_OPTEE_SUPPORT=n
	help
	  Novatek iVot Hash Engine Command support.

config NVT_IVOT_RSA_CMD
	bool "To support rsa engine command"
	depends on NVT_IVOT_SOC && NVT_IVOT_OPTEE_SUPPORT=n
	help
	  Novatek iVot RSA Engine Command support.

config NVT_IVOT_DUAL_RTOS
	bool "Dual RTOS mechanism"
	default n
	help
	  An alternate rtos mechanism only for RTOS_APP_MAIN = uvc

endmenu		# Novatek IVOT features
```

## src/boards/nt98633/hiboot/uboot/board/novatek/nvt-na51090-a64/nvt_pcie/Kconfig
```kconfig
if ARCH_NOVATEK
	if TARGET_NA51090_A64 || TARGET_NA51090
		menu "Novatek PCIE features"
		config NVT_PCIE
				bool "NVT PCIE support"

		config NVT_PCIE_DAUGHTER_BRD
				bool "Enable nvt pcie daughter board"
				depends on NVT_PCIE && NVT_IVOT_SOC_UTILS
				default n
				help
				This option is used to enable NVT pcie boot daughter board.

		config NVT_PCIE_EP_VENDOR_ID
				hex "NVT PCIE EP Vendor ID"
				depends on NVT_PCIE_DAUGHTER_BRD
				default 0x1E09
				help
				Overwrite your EP PCIE VID

		config NVT_PCIE_EP_DEV_ID
				hex "NVT PCIE EP Device ID"
				depends on NVT_PCIE_DAUGHTER_BRD
				default 0x0005
				help
				Overwrite your EP PCIE PID

		config NVT_PCIE_EP_BAR0_SIZE
				int "NVT PCIE EP BAR0 size"
				depends on NVT_PCIE_DAUGHTER_BRD
				default 8
				range 0 13
				help
				0:		1 MB (2^20)
				1:		2 MB (2^21)
				N:		2^(20+N)
				8:		256 MB (2^28) (default)
				...
				13:		8 GB (2^33) (max)

		config NVT_PCIE_EP_BAR2_EN
				bool "NVT PCIE EP BAR2 enabled"
				depends on NVT_PCIE_DAUGHTER_BRD
				default y
				help
				Enable/Disable EP PCIE BAR2

		config NVT_PCIE_MAPPING
				bool "Support for pcie memory mapping"
				depends on NVT_PCIE
				default n
				help
				Enabling this will make a U-Boot binary that is capable of being
				pcie initialization and memory mapping

		config NVT_PCIE_TEST_MODE
				int "NVT PCIE test mode"
				default 1
				depends on NVT_PCIE_MAPPING
				help
					0: test RC loopback (test mode)
					1: test RC side in cascade
					2: test EP side in cascade

		config NVT_PCIE_CASCADE
				bool "Enable 63x pcie cascade"
				depends on NVT_PCIE_MAPPING && TARGET_NA51090_A64 && NVT_IVOT_SOC_UTILS && NVT_IVOT_SOC_FW_UPDATE_SUPPORT
				default n
				help
				This option is used to enable NVT pcie boot ep mode.
		endmenu
	endif # TARGET_NA51090 || TARGET_NA51090_A64
endif # ARCH_NOVATEK
```

## src/boards/nt98633/hiboot/uboot/drivers/crypto/Kconfig
```kconfig
menu "Hardware crypto devices"

source drivers/crypto/fsl/Kconfig

if TARGET_NA51055
source drivers/crypto/nvt/na51055/Kconfig
endif

if TARGET_NA51089
source drivers/crypto/nvt/na51089/Kconfig
endif

if TARGET_NA51090 || TARGET_NA51090_A64
source drivers/crypto/nvt/na51090/Kconfig
endif

if TARGET_NA51103
source drivers/crypto/nvt/na51103/Kconfig
endif

if TARGET_NA51102 || TARGET_NA51102_A64
source drivers/crypto/nvt/na51102/Kconfig
endif


endmenu
```

## src/boards/nt98633/hiboot/uboot/drivers/crypto/nvt/na51102/Kconfig
```kconfig
config NVT_CRYPTO
	bool "NovaTek NA51102 Crypto Driver Support"
	depends on NVT_IVOT_SOC && NVT_IVOT_OPTEE_SUPPORT=n
	help
	  Novatek NA51102 processors have crypto engine accelerator.
	  Select this if you want to use the crypto engine for AES/DES/3DES
	  algorithms.

config NVT_HASH
	bool "NovaTek NA51102 Hash Driver Support"
	depends on NVT_IVOT_SOC && NVT_IVOT_OPTEE_SUPPORT=n
	help
	  Novatek NA51102 processors have hash engine accelerator.
	  Select this if you want to use the hash engine for SHA1/SHA256 algorithms.

config NVT_RSA
	bool "NovaTek NA51102 RSA Driver Support"
	depends on NVT_IVOT_SOC && NVT_IVOT_OPTEE_SUPPORT=n
	help
	  Novatek NA51102 processors have rsa engine accelerator.
	  Select this if you want to use the rsa engine.
```

## src/boards/nt98633/hiboot/uboot/drivers/video/novatek/nvt_panel/Kconfig
```kconfig
#
# Panel drivers configuration
#
#

config DISP_VIDEO_HDMITX_IDE
	bool "HDMI support for IDE"
	depends on VIDEO_LOGO && (TARGET_NA51102 || TARGET_NA51102_A64)
	help
		Novatek HDMITX IF support for IDE

choice
	prompt "Novatek Panel Selection menu"
	default DISP_IF8B_LCD1_PW35P00_HX8238D
	depends on VIDEO_LOGO
	help
	  select panel for device object.

config DISP_IF8B_LCD1_PW35P00_HX8238D
	bool "To support PW35P00 serial panel"
	depends on VIDEO_LOGO
	help
	  Novatek Serial IF 8bit Panel PW35P00 support.

config DISP_IF8B_LCD1_AUCN01
	bool "To support AUCN01 serial panel"
	depends on VIDEO_LOGO
	help
	  Novatek Serial IF 8bit Panel AUCN01 support.

config DISP_IF8B_LCD1_TP2803
        bool "To support TP2803 serial panel"
        depends on VIDEO_LOGO
        help
          Novatek Serial IF 8bit Panel TP2803 support.

config DISP_IF8B_LCD1_PSD300
        bool "To support PSD300 serial panel"
        depends on VIDEO_LOGO
        help
          Novatek Serial IF 8bit Panel PSD300 support.

config DISP_IFDSI_LCD1_UT35067A0
        bool "To support UT35067A0  panel"
        depends on VIDEO_LOGO
        help
          Novatek Serial IF DSI Panel UT35067A0 support.

config DISP_IFNONE
        bool "To support NULL panel"
        depends on VIDEO_LOGO
        help
          Novatek NULL panel support.

endchoice
```
