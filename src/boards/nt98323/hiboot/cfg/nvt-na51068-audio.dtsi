/*
 * Novatek Ltd. NA51068 BSP part of dts
 *
 * Cortex-A9
 *
 */

/ {
		audio_in_part {
			  /*<ssp_num>,<enable>,<ssp_chan>,<sample_size>,<sample_rate>,<ssp_clock>,<bit_clock>,<ssp_master>,<live_sound_ch> */
			ssp =
				<0    >,  <1     >,<16      >,<16         >,<8000       >,<12288000 >,<2048000 >, <1         >,< (-1)        >,
				<6    >,  <0     >,<1       >,<16         >,<8000       >,<12288000 >,<3072000 >, <1         >,< (-1)        >,
				<(-1) >,  <0     >,<1       >,<16         >,<8000       >,<12288000 >,<512000  >, <1         >,< (-1)        >,
				<(-1) >,  <0     >,<1       >,<16         >,<8000       >,<12288000 >,<512000  >, <1         >,< (-1)        >;
		};
		audio_out_part {
			/*<enable>,<resample_ratio>,<playback_chmap> */
			ssp =
				<1     >, <1          >,< (-1)         >,
				<1     >, <6          >,< (-1)         >,
				<0     >, <1          >,< (-1)         >,
				<0     >, <1          >,< (-1)         >;
		};	
};

